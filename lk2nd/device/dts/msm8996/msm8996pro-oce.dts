// SPDX-License-Identifier: BSD-3-Clause

#include <skeleton64.dtsi>
#include <lk2nd.dtsi>

/ {
 	model = "HTC Corporation. MSM8996pro v1.1 + PMI8996 OCE PVT";
	compatible = "qcom,msm8996", "htc,oce";
	qcom,msm-id =
  	<QCOM_ID_MSM8996 0x20001>,
		<QCOM_ID_MSM8996 0x30000>,
		<QCOM_ID_MSM8996 0x30001>,
		<QCOM_ID_MSM8996SG 0x10001>;
	qcom,board-id = <80 0>, <81 0>;
	qcom,pmic-id = <0x20009 0x10013 0x00 0x00>;
};

&lk2nd {
	model = "HTC Corporation. MSM8996pro v1.1 + PMI8996 OCE PVT";
	compatible = "qcom,msm8996", "lk2nd,device", "htc,oce";
};
